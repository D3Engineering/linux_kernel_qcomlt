## Documentation/devicetree/bindings/media/i2c/ov5640.txt
```
* Omnivision 1/4-Inch 5Mp CMOS Digital Image Sensor

The Omnivision OV5640 is a 1/4-Inch CMOS active pixel digital image sensor with
an active array size of 2592H x 1944V. It is programmable through a serial I2C
interface.

Required Properties:
- compatible: Value should be "ovti,ov5640".
- clocks: Reference to the xclk clock.
- clock-names: Should be "xclk".
- clock-frequency: Frequency of the xclk clock.
- enable-gpios: Chip enable GPIO. Polarity should be GPIO_ACTIVE_LOW for this sensor.
- reset-gpios: Chip reset GPIO. Polarity is GPIO_ACTIVE_LOW for this sensor.
- vdddo-supply: Chip digital IO regulator.
- vdda-supply: Chip analog regulator.
- vddd-supply: Chip digital core regulator.
- qcom,use_cci: Use the CCI bus driver instead of the I2C device.
- ovti,vflip: Flip the vertical orietnation of the sensor.
- ovti,hflip: Flip the horizontal orietnation of the sensor.

The device node must contain one 'port' child node for its digital output
video port, in accordance with the video interface bindings defined in
Documentation/devicetree/bindings/media/video-interfaces.txt.

Example:

	&i2c1 {
		...

		ov5640: ov5640@78 {
			compatible = "ovti,ov5640";
			reg = <0x78>;
			
			ovti,vflip;
			ovti,hflip;			

			qcom,use_cci;
			enable-gpios = <&gpio1 6 GPIO_ACTIVE_LOW>;
			reset-gpios = <&gpio5 20 GPIO_ACTIVE_LOW>;
			pinctrl-names = "default";
			pinctrl-0 = <&camera_rear_default>;

			clocks = <&clks 200>;
			clock-names = "xclk";
			clock-frequency = <23880000>;

			vdddo-supply = <&camera_dovdd_1v8>;
			vdda-supply = <&camera_avdd_2v8>;
			vddd-supply = <&camera_dvdd_1v2>;

			port {
				ov5640_ep: endpoint {
					clock-lanes = <1>;
					data-lanes = <0 2>;
					remote-endpoint = <&csi0_ep>;
				};
			};
		};
	};
```
